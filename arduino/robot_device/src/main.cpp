#include <Arduino.h>
//#define DEBUG

// Ultrasonic Settings
const uint32_t kTimeout = 60000;
const int kTrigAllPin = 5;  // All receivers are connected to this pin
const int kLeftEchoPin = 6;  // needs to be between 2 and 7 (inclusive)
const int kRightEchoPin = 7;  // needs to be between 2 and 7 (inclusive)
const uint32_t kReceiverTimeout = 110000;

// Masks for echo pins
const uint8_t kLeft = (1 << kLeftEchoPin);
const uint8_t kRight = (1 << kRightEchoPin);
const uint8_t kBoth = kLeft | kRight;

// Ultrasonic data
struct TimeData {
    uint32_t timeLeft;
    uint32_t timeRight;
};
struct TimeData uTimeData;

// IR Settings
const int kNrIRSensors = 3;
const int kIRLowerBound = 5;
const int kIRUpperBound = 80;
int ir_receiver_pins[] = {A0, A1, A2};
uint32_t ir_data[] = {0, 0, 0};

// Radio settings
const String kRadioRequestCode = "$$$";

// Comm Settings
const uint32_t kNoSig = 0xFFFFFFFF;  // Code for no signal received
const char kNoSigSent = '-'; // Code to send for no signal
const String uID = "U";  // This ID identifies ultrasonic data
const String iID = "I";  // This ID identifies IR data
const String kOpenMsg = "<";   // Code identifies beginning of message
const String kCloseMsg = ">";  // Code identifies end of message
const String kLineSep = "|";

// The must take at least this long (ms) because of user device
const uint32_t kMinLoopTime = 147;

/*
 * Used to activate the receivers
 */
void activateUltrasonic(int trigPin);
/*
 * Sends radio signal to user's device to cause it to emit an ultrasonic pulse.
 */
void requestSignal();
/*
 * Waits for signal to be received on both receivers and returns the time since
 * `startTime` it took in the `timeLeft` and `timeRight` pointers. If no signal
 * is received, the respective output is set to 0xFFFFFFFF (2^32 - 1).
 */
void measureTimes(uint32_t startTime);
/*
 * Uses port manipulation to read all echo pins (specified by the `mask`)
 * extremely fast (~0.1 us).
 * (`PIND` is a byte containing values of pins 0-7.)
 */
uint8_t getEcho(uint8_t mask) {return PIND & mask;}

/*
 * Converts a voltage to a distance
 */
uint32_t convertVoltageToDistance(int voltage);

/*
 * Listens for IR signal
 */
void listenForIR();

/*
 * Sends IR data over serial
 */
void sendIRData();

/*
 * Sends data generated by ultrasonic sensors over serial
 */
void sendUltraData();

void setup()
{
  // Radio setup
  pinMode(8,OUTPUT); // switch off the radio
  digitalWrite(8,HIGH);
  pinMode(4,OUTPUT); // switch on the radio
  digitalWrite(4,LOW); // ensure the radio is not sleeping
  Serial.begin(115200);

  // Tracking pins setup
  pinMode(kTrigAllPin, OUTPUT);
  digitalWrite(kTrigAllPin, LOW);
  pinMode(kLeftEchoPin, INPUT);
  pinMode(kRightEchoPin, INPUT);
}

void loop()
{
  //Current time
  uint32_t t = millis();

  activateUltrasonic(kTrigAllPin);
  delayMicroseconds(600);
  uint32_t t0 = micros();
  // Both echo pins should be high now
  if (getEcho(kBoth) != kBoth) {
    Serial.print("E0");  // ERROR: Unexpected echo state
    Serial.print(kLineSep);
  }
  requestSignal();

  // Now we have about 20 ms to do stuff
  listenForIR();  // This only takes about 2.6 ms

  measureTimes(t0);

  // Now we have uTimeData.timeLeft and uTimeData.timeLeft. We can send them to
  // EV3. We can also do other stuff here.

  // Send data over serial to the ev3 brick
  digitalWrite(8,LOW);
  delay(4);
  sendUltraData();
  sendIRData();
  delay(1);
  digitalWrite(8,HIGH);

  // If necessary, wait before next iteration
  t = millis() - t;
  if (t < kMinLoopTime)
    delay(kMinLoopTime - t);//*/

#ifdef DEBUG
  Serial.println(t);
#endif  // DEBUG
}

void requestSignal() {
  Serial.print(kRadioRequestCode);
  Serial.print(kLineSep);
  Serial.flush();
}

// Ultrasonic Functions
void measureTimes(uint32_t startTime)
{
  uint32_t &timeLeft = uTimeData.timeLeft;
  uint32_t &timeRight = uTimeData.timeRight;
  timeLeft = kNoSig;
  timeRight = kNoSig;

  uint8_t echo = getEcho(kBoth);
  // Both echo pins should still be high
  if (echo != kBoth) {
    Serial.print("E1");  // ERROR: Listening too late
    Serial.print(kLineSep);
    return;
  }
  // Wait for echo pins to go low and note times
  uint32_t start = micros();
  uint32_t nr_iters = 0;
  while (echo != 0x00) {
    echo = getEcho(kBoth);
    if ((timeLeft == kNoSig) && ((echo & kLeft) == 0))
      timeLeft = micros() - startTime;
    if ((timeRight == kNoSig) && ((echo & kRight) == 0))
      timeRight = micros() - startTime;
    //every 1000 iterations, we check if the loop runtime exceeded the timeout
    //If it did, break to avoid waiting unnecessarily for a sensor timeout
    //Do it only every 1000 iterations because micros() is an expensive op
    //if first part of condition is false, second part won't be evaluted
    if (nr_iters % 1000 == 0 && (micros()-start) > kTimeout ) break;
  }

  // Check for timeouts
  if (timeLeft > kReceiverTimeout) timeLeft = kNoSig;
  if (timeRight > kReceiverTimeout) timeRight = kNoSig;
}

void activateUltrasonic(int trigPin)
{
  digitalWrite(trigPin, LOW);
  delayMicroseconds(2);
  digitalWrite(trigPin, HIGH);
  delayMicroseconds(10);
  digitalWrite(trigPin, LOW);
}

/* IR Functions */
uint32_t convertVoltageToDistance(int voltage){
  return (voltage > 20) ? (uint32_t)(4800/(voltage-20)) : kNoSig;
}

void listenForIR(){
  const int nr_iterations = 5;
  uint32_t distances[nr_iterations][kNrIRSensors];
  for (int i = 0 ; i < nr_iterations ; ++i)
    for (int sensor = 0 ; sensor < kNrIRSensors ; ++sensor)
      distances[i][sensor] = convertVoltageToDistance(analogRead(ir_receiver_pins[sensor]));

  double means[] = {0.0, 0.0, 0.0};

  for (int i = 0 ; i < nr_iterations ; ++i)
    for (int sensor = 0 ; sensor < kNrIRSensors ; ++sensor)
      means[sensor] += distances[i][sensor] / nr_iterations;

  for(int i = 0; i < kNrIRSensors; i++ ) {
    if (means[i] > kIRUpperBound || means[i] < kIRLowerBound) ir_data[i] = kNoSig;
    else ir_data[i] = (uint32_t) means[i];
  }
}

void sendUltraData() {
  Serial.print(kOpenMsg);
  Serial.print(uID);
  if (uTimeData.timeLeft == kNoSig) Serial.print(kNoSigSent); else Serial.print(uTimeData.timeLeft);
  Serial.print(" ");
  if (uTimeData.timeRight == kNoSig) Serial.print(kNoSigSent); else Serial.print(uTimeData.timeRight);
  Serial.print(kCloseMsg);
  Serial.print(kLineSep);
  Serial.flush();
}

void sendIRData(){
  Serial.print(kOpenMsg);
  Serial.print(iID);
  for(int i = 0; i < kNrIRSensors - 1; ++i){
    if (ir_data[i] == kNoSig) Serial.print(kNoSigSent); else Serial.print(ir_data[i]);
    Serial.print(" ");
  }
  if (ir_data[kNrIRSensors - 1] == kNoSig) Serial.print(kNoSigSent); else Serial.print(ir_data[kNrIRSensors - 1]);
  Serial.print(kCloseMsg);
  Serial.print(kLineSep);
  Serial.flush();
}
